## config/boards/shields/cradias/Kconfig.defconfig
```kconfig
# Copyright (c) 2020 The ZMK Contributors
# SPDX-License-Identifier: MIT

if SHIELD_CRADIAS_LEFT

config ZMK_KEYBOARD_NAME
    default "Cradias"

config ZMK_SPLIT_ROLE_CENTRAL
    default y

endif

if SHIELD_CRADIAS_LEFT || SHIELD_CRADIAS_RIGHT

config ZMK_SPLIT
    default y

endif
```

## config/boards/shields/cradias/Kconfig.shield
```kconfig
# Copyright (c) 2020 The ZMK Contributors
# SPDX-License-Identifier: MIT

config SHIELD_CRADIAS_LEFT
    def_bool $(shields_list_contains,cradias_left)

config SHIELD_CRADIAS_RIGHT
    def_bool $(shields_list_contains,cradias_right)
```

## config/boards/shields/simon/Kconfig.shield
```kconfig
config SHIELD_SIMON_LEFT
    def_bool $(shields_list_contains,simon_left)

config SHIELD_SIMON_RIGHT
    def_bool $(shields_list_contains,simon_right)
```

## config/boards/shields/simono/Kconfig.defconfig
```kconfig
if SHIELD_SIMONO_LEFT

config ZMK_KEYBOARD_NAME
    default "simono"

config ZMK_SPLIT_ROLE_CENTRAL
    default y

endif

if SHIELD_SIMONO_LEFT || SHIELD_SIMONO_RIGHT

config ZMK_SPLIT
    default y

endif
```

## config/boards/shields/simono/Kconfig.shield
```kconfig
config SHIELD_SIMONO_LEFT
    def_bool $(shields_list_contains,simono_left)

config SHIELD_SIMONO_RIGHT
    def_bool $(shields_list_contains,simono_right)
```
